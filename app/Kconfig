## app/Kconfig
```kconfig
source "Kconfig.zephyr"

config APP_HEARTBEAT_PERIOD_MS
    int "Heart beat period ms"
    default 500
    range 100 2000
    help 
        Heart beat period.

menuconfig LED_SUBSYSTEM
    bool "LED Subsystem"
    default y   

if LED_SUBSYSTEM

choice 
    prompt "LED blink sleep time"
    default LED_BLINK_SLEEP_TIME_1SEG 
    
config LED_BLINK_SLEEP_TIME_250MS
    bool "Fast (250ms)"
config LED_BLINK_SLEEP_TIME_1SEG
    bool "Medium (1s)"
config LED_BLINK_SLEEP_TIME_2SEG
    bool "Slow (2s)"
    
endchoice

config LED_BLINK_SLEEP_TIME
    int
    default 250 if LED_BLINK_SLEEP_TIME_250MS
    default 1000 if LED_BLINK_SLEEP_TIME_1SEG
    default 2000 if LED_BLINK_SLEEP_TIME_2SEG
    default 0

menuconfig ADVANCED_LED_SETTINGS
    bool "Advanced led settings"
    default n

config LED_BRIGHTNESS
    int "Led brightness"
    range 0 100
    default 100

config LED_FADE
    int "Led fade"
    range 0 5000
    default 500

menu "Led expert settings"
    visible if ADVANCED_LED_SETTINGS

config LED_DEBUGGING
    bool "Enable led debugging"
    default n

config LED_CUSTOM_BLINK_PATTERN
    bool "Enable custom blink pattern"
    default n

endmenu

endif
```

## app/boards/our_board_copy_method/board.yml
```yaml
board:
  name: our_board_copy_method
  full_name: Our board copy method
  vendor: iomico
  socs:
  - name: nrf52832
```

## app/boards/our_board_from_scratch_method/Kconfig.def_config
```kconfig
if BOARD_OUR_BOARD_FROM_SCRATCH_METHOD

config HW_STACK_PROTECTION
	default ARCH_HAS_STACK_PROTECTION

endif # BOARD_OUR_BOARD_FROM_SCRATCH_METHOD
```

## app/boards/our_board_from_scratch_method/Kconfig.our_board_from_scratch_method
```kconfig
config BOARD_OUR_BOARD_FROM_SCRATCH_METHOD
    select SOC_NRF52832_QFAA if BOARD_OUR_BOARD_FROM_SCRATCH_METHOD
```

## app/boards/our_board_from_scratch_method/board.yml
```yaml
board:
  name: our_board_from_scratch_method
  full_name: Our board from scratch method
  vendor: iomico
  socs:
    - name: nrf52832  
```

## app/drivers/our_driver/Kconfig
```kconfig
config OUR_DRIVER
    bool "Our driver implemetation"
    default y
    help
        Enable our driver implementation.
```
